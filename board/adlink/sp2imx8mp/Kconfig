## board/adlink/sp2imx8mp/Kconfig
```kconfig
if TARGET_ADLINK_SP2IMX8MP

config SYS_BOARD
	default "sp2imx8mp"

config SYS_VENDOR
	default "adlink"

config SYS_CONFIG_NAME
	default "sp2imx8mp"

config IMX_CONFIG
	default "board/adlink/sp2imx8mp/imximage-8mp-lpddr4.cfg"

config IMX8MP_GP5_LOCK_UPDATE
	bool "Enable burn GP5_LOCK fuse at boot"
	help
	  Select to check the GP5_LOCK fuse and burn it to WP+OP

choice
	prompt "Adlink lpddr4 memory size"
	depends on TARGET_ADLINK_SP2IMX8MP

config LPDDR4_ALL
	bool "All range of lpddr4 memories"

config LPDDR4_2GB
	bool "2GB lpddr4 memory"

config LPDDR4_4GB
	bool "4GB lpddr4 memory"

config LPDDR4_8GB
	bool "8GB lpddr4 memory"

endchoice

endif
```
